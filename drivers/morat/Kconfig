## drivers/morat/Kconfig
```kconfig
source "drivers/morat/exoticaffinity/Kconfig"
source "drivers/morat/exoticappboost/Kconfig"
source "drivers/morat/exotic_thermal/Kconfig"
```

## drivers/morat/exotic_thermal/Kconfig
```kconfig
config EXOTIC_THERMAL
	tristate "ExoticThermal Adaptive"
	default y
	help
	  Restore big core max frequency if thermal throttling stuck,
	  with adaptive hysteresis based on temperature.
```
